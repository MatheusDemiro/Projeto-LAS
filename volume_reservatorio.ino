#include "RTClib.h" //Biblioteca para manipulação do rtc data logger shield
#include <Ultrasonic.h>
#include <avr/pgmspace.h>
#include <SPI.h>
#include <SD.h>

#define ECHO 8
#define TRIG 7
#define ARRAY_SIZE 580

Ultrasonic ultrasonic(TRIG, ECHO); //Instância da biblioteca Ultrassonic

RTC_DS1307 rtc;

File arquivoLog;
File reservatorioLog;
const byte sd_pin = 10; //Acesso ao SD card
double volume;
unsigned int distancia;

//Array com os volumes pre-calculados
//495.241215690616, 494.227554640996, 493.213893591377, 492.200232541757, 491.186571492138, 490.172910442518, 489.159249392899, 488.145588343279, 487.131927293659, 486.11826624404, 485.10460519442, 484.090944144801, 483.077283095181,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 0
const uint16_t array_volume[ARRAY_SIZE] PROGMEM = {495, 494, 493, 492, 491, 490, 489, 488, 487, 486, 485, 484, 483,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 1, 0};

void setup()
{
  Serial.begin(115200);
  //Inicializando o cartao SD
  Serial.println("Inicializando cartão SD...");
  if (!SD.begin(sd_pin)){
    Serial.println("Falha na inicialização do cartão SD!\n");
    while (1); //fica aqui para sempre
  }
  Serial.println("Cartão SD inicializado com sucesso.");
  if (arquivoLog = SD.open("ini.txt", FILE_WRITE)){
    Serial.println("Arquivo encontrado.");
    arquivoLog.println("Cartão SD iniciado com sucesso.");
  } else{
    Serial.println("Arquivo 'inicializacao.txt' não encontrado.");
    while (1);
  }

  //Valida a inicializacao do RTC
  if (!rtc.begin()){
    arquivoLog.println("RTC não encontrado!");
    Serial.println("RTC não encontrado!");
    arquivoLog.close();
    while (1); //fica aqui para sempre
  }
  if (!rtc.isrunning()){
    arquivoLog.println("RTC não está funcionando!");
    Serial.println("RTC não está funcionando!");

    rtc.adjust(DateTime(F(__DATE__), F(__TIME__))); //Ajuste de data e hora na compilação, pela substituição das macros

    //A linha abaixo permite ajustar manualmente a data e hora do RTC
    //Formato: DateTime(ano, mes, dia, hora, minuto, segundo)
    //rtc.adjust(DateTime(2014, 1, 21, 3, 0, 0));
  }
  arquivoLog.close();
}

void loop(void)
{
  distancia = calcularDistancia(); //Distancia informada pelo sensor ultrassonico
  if (distancia > 0){
    delay(300000);//Atualizar para realizar cálculo de distância de 5 em 5 minutos
    volume = pgm_read_word_near(array_volume+distancia-1);
    Serial.println(volume);
    Serial.println(distancia);
    log("Volume calculado com sucesso!", volume, distancia);
  }
  else{
    log("Reservatório cheio.", volume, distancia);
  }
}

unsigned int calcularDistancia(void){
  return ultrasonic.distanceRead();
}

void log(char *msg, float volume, int distancia){
  Serial.println("Loggin..");
  if (reservatorioLog = SD.open("regv.txt", FILE_WRITE)){
    DateTime now = rtc.now();

    reservatorioLog.println();
    reservatorioLog.print(now.day(), DEC);
    reservatorioLog.print("/");
    reservatorioLog.print(now.month(), DEC);
    reservatorioLog.print("/");
    reservatorioLog.print(now.year(), DEC);
    reservatorioLog.print(" ");
    reservatorioLog.print(now.hour(), DEC);
    reservatorioLog.print(":");
    reservatorioLog.print(now.minute(), DEC);
    reservatorioLog.print(":");
    reservatorioLog.print(now.second(), DEC);
    reservatorioLog.print(" ");
    reservatorioLog.print("volume: ");
    reservatorioLog.print(volume);
    reservatorioLog.print(" ");
    reservatorioLog.print("distancia: ");
    reservatorioLog.print(distancia);
    reservatorioLog.close();
    Serial.println("Done.");
  }else{
    arquivoLog = SD.open("ini.txt", FILE_WRITE);
    arquivoLog.println("Erro ao abrir arquivo 'regv.txt'.");
    arquivoLog.close();
    Serial.println("Erro ao abrir arquivo 'regv.txt'.");
  }
}
